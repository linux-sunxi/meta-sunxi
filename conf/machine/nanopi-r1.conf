## conf/machine/nanopi-r1.conf
```bitbake
#@TYPE: Machine
#@NAME: NanoPi R1
#@DESCRIPTION: Machine configuration for the FriendlyARM NanoPi R1, based on #the Allwinner H3 CPU

require conf/machine/include/sun8i.inc

KERNEL_DEVICETREE = "allwinner/sun8i-h3-nanopi-r1.dtb"
UBOOT_MACHINE = "nanopi_r1_defconfig"
```

## conf/machine/olinuxino-a10lime.conf
```bitbake
#@TYPE: Machine
#@NAME: Olimex A10-OLinuXino Lime (4GB) Board
#@DESCRIPTION: Machine configuration for the Olimex A10-OLinuXino Lime Board, based on Allwinner A10 CPU
#https://github.com/OLIMEX/OLINUXINO

require conf/machine/include/sun4i.inc

KERNEL_DEVICETREE = "allwinner/sun4i-a10-olinuxino-lime.dtb"
UBOOT_MACHINE = "A10-OLinuXino-Lime_config"
SUNXI_FEX_FILE = "sys_config/a10/a10-olinuxino-lime.fex"
```

## conf/machine/olinuxino-a10s.conf
```bitbake
#@TYPE: Machine
#@NAME: Olimex A10S-OLinuXino-MICRO Board
#@DESCRIPTION: Machine configuration for Olimex A10S-OLinuXino-MICRO Board, based on Allwinner A10s CPU
#https://github.com/OLIMEX/OLINUXINO

require conf/machine/include/sun5i.inc

KERNEL_DEVICETREE = "allwinner/sun5i-a10s-olinuxino-micro.dtb"
UBOOT_MACHINE = "A10s-OLinuXino-M_config"
SUNXI_FEX_FILE = "sys_config/a10s/a10s-olinuxino-m.fex"
```

## conf/machine/olinuxino-a13.conf
```bitbake
#@TYPE: Machine
#@NAME: Olimex A13-OLinuXino Board
#@DESCRIPTION: Machine configuration for the Olime A13-OLinuXino Board, base on allwinner a13 CPU
#https://github.com/OLIMEX/OLINUXINO

require conf/machine/include/sun5i.inc

KERNEL_DEVICETREE = "allwinner/sun5i-a13-olinuxino.dtb"
UBOOT_MACHINE = "A13-OLinuXino_config"
SUNXI_FEX_FILE = "sys_config/a13/a13-olinuxino.fex"
```

## conf/machine/olinuxino-a20.conf
```bitbake
#@TYPE: Machine
#@NAME: Olimex A20-OLinuXino Board
#@DESCRIPTION: Machine configuration for the Olimex A20-OLinuXino Board, based on Allwinner A20 CPU
#https://github.com/OLIMEX/OLINUXINO

require conf/machine/include/sun7i.inc

KERNEL_DEVICETREE = "allwinner/sun7i-a20-olinuxino-micro.dtb"
UBOOT_MACHINE = "A20-OLinuXino_MICRO_config"
SUNXI_FEX_FILE = "sys_config/a20/a20-olinuxino_micro.fex"
```

## conf/machine/olinuxino-a20lime2-emmc.conf
```bitbake
#@TYPE: Machine
#@NAME: Olimex A20-OLinuXino Lime2 Board with 4GB eMMC
#@DESCRIPTION: Machine configuration for the Olimex A20-OLinuXino Lime2 Board with 4GB eMMC, based on Allwinner A20 CPU
#https://github.com/OLIMEX/OLINUXINO

require conf/machine/include/sun7i.inc

KERNEL_DEVICETREE = "allwinner/sun7i-a20-olinuxino-lime2-emmc.dtb"
UBOOT_MACHINE = "A20-OLinuXino-Lime2-eMMC_config"
SUNXI_FEX_FILE = "sys_config/a20/a20-olinuxino_lime2.fex"
```

## conf/machine/olinuxino-a20lime2.conf
```bitbake
#@TYPE: Machine
#@NAME: Olimex A20-OLinuXino Lime2 (4GB) Board
#@DESCRIPTION: Machine configuration for the Olimex A20-OLinuXino Lime2 Board, based on Allwinner A20 CPU
#https://github.com/OLIMEX/OLINUXINO

require conf/machine/include/sun7i.inc

KERNEL_DEVICETREE = "allwinner/sun7i-a20-olinuxino-lime2.dtb"
UBOOT_MACHINE = "A20-OLinuXino-Lime2_config"
SUNXI_FEX_FILE = "sys_config/a20/a20-olinuxino_lime2.fex"
```

## conf/machine/olinuxino-a20som.conf
```bitbake
#@TYPE: Machine
#@NAME: Olimex A20-SOM
#@DESCRIPTION: Machine configuration for the Olimex A20-SOM Evaluation Board, based on Allwinner A20 CPU
#https://github.com/OLIMEX/SOM

require conf/machine/include/sun7i.inc

KERNEL_DEVICETREE = "allwinner/sun7i-a20-olimex-som-evb.dtb"
UBOOT_MACHINE = "A20-Olimex-SOM-EVB_config"
SUNXI_FEX_FILE = "sys_config/a20/olimex_a20_som.fex"
```

## conf/machine/olinuxino-a20som204.conf
```bitbake
#@TYPE: Machine
#@NAME: Olimex A20-SOM204
#@DESCRIPTION: Machine configuration for the Olimex A20-SOM204 Evaluation Board, based on Allwinner A20 CPU
#https://github.com/OLIMEX/SOM204

require conf/machine/include/sun7i.inc

KERNEL_DEVICETREE = "allwinner/sun7i-a20-olimex-som204-evb.dtb"
UBOOT_MACHINE = "A20-Olimex-SOM204-EVB_defconfig"
```

## conf/machine/orange-pi-3lts.conf
```bitbake
#@TYPE: Machine
#@NAME: orange-pi-3lts
#@DESCRIPTION: Machine configuration for the Orange Pi 3 LTS , based on Allwinner H6 CPU
# Note: Some boards have faulty RTC a fix is included by default
# a workarround in the dts ins include by default but in can removed adding
# KERNEL_FEATURES:remove = " bsp/orange-pi-3lts/fix-rtc.scc" to local.conf

require conf/machine/include/sun50i-h6.inc

KERNEL_DEVICETREE = "allwinner/sun50i-h6-orangepi-3-lts.dtb"
UBOOT_MACHINE = "orangepi_3_lts_defconfig"

SPL_BINARY = "u-boot-sunxi-with-spl.bin"

# as for now neither graphics nor audio is supported
MACHINE_FEATURES:remove = " x11 alsa rtc"
MACHINE_FEATURES:append = " bluetooth wifi"

# fiwrware needed for wifi + bt
MACHINE_EXTRA_RRECOMMENDS += " uwe5622-firmware"

# Load modules for wifi & bt
# Note: fo wifi a custom hci attach userspace sofware is needed that is not included in the layer
KERNEL_MODULE_AUTOLOAD += " sprdwl_ng sprdbt_tty "
```

## conf/machine/orange-pi-lite.conf
```bitbake
#@TYPE: Machine
#@NAME: orange-pi-lite
#@DESCRIPTION: Machine configuration for the orange-pi-lite, based on Allwinner H3 CPU

require conf/machine/include/sun8i.inc

KERNEL_DEVICETREE = "allwinner/sun8i-h3-orangepi-lite.dtb"
UBOOT_MACHINE = "orangepi_lite_defconfig"
```

## conf/machine/orange-pi-one.conf
```bitbake
#@TYPE: Machine
#@NAME: orange-pi-one
#@DESCRIPTION: Machine configuration for the orange-pi-one, base on allwinner H3 CPU

require conf/machine/include/sun8i.inc

KERNEL_DEVICETREE = "allwinner/sun8i-h3-orangepi-one.dtb"
UBOOT_MACHINE = "orangepi_one_defconfig"
```

## conf/machine/orange-pi-pc-plus.conf
```bitbake
#@TYPE: Machine
#@NAME: orange-pi-pc-plus
#@DESCRIPTION: Machine configuration for the orange-pi-pc-plus, base on allwinner H3 CPU

require conf/machine/include/sun8i.inc

KERNEL_DEVICETREE = "allwinner/sun8i-h3-orangepi-pc-plus.dtb"
UBOOT_MACHINE = "orangepi_pc_plus_defconfig"
```

## conf/machine/orange-pi-pc.conf
```bitbake
#@TYPE: Machine
#@NAME: orange-pi-one
#@DESCRIPTION: Machine configuration for the orange-pi-one, base on allwinner H3 CPU

require conf/machine/include/sun8i.inc

KERNEL_DEVICETREE = "allwinner/sun8i-h3-orangepi-pc.dtb"
UBOOT_MACHINE = "orangepi_pc_defconfig"
```

## conf/machine/orange-pi-prime.conf
```bitbake
#@TYPE: Machine
#@NAME: orange-pi-prime
#@DESCRIPTION: Machine configuration for the orange-pi-prime, base on Allwinner H5 CPU

require conf/machine/include/sun50i.inc
require conf/machine/include/hardware/ap6212a.inc

KERNEL_DEVICETREE = "allwinner/sun50i-h5-orangepi-prime.dtb"
UBOOT_MACHINE = "orangepi_prime_defconfig"

MACHINE_FEATURES:append = " bluetooth wifi"
MACHINE_EXTRA_RRECOMMENDS:append = " linux-firmware-rtl8723"
```

## conf/machine/orange-pi-r1.conf
```bitbake
#@TYPE: Machine
#@NAME: orange-pi-r1
#@DESCRIPTION: Machine configuration for the orange-pi-r1, base on allwinner H2+ CPU

require conf/machine/include/sun8i.inc

KERNEL_DEVICETREE = "allwinner/sun8i-h2-plus-orangepi-r1.dtb"
UBOOT_MACHINE = "orangepi_r1_defconfig"
```

## conf/machine/orange-pi-zero-plus2-h3.conf
```bitbake
#@TYPE: Machine
#@NAME: orange-pi-zero-plus2-h3
#@DESCRIPTION: Machine configuration for the orange-pi-zero-plus2, based on Allwinner H3 CPU

require conf/machine/include/sun8i.inc
require conf/machine/include/hardware/ap6212a.inc

KERNEL_DEVICETREE = "allwinner/sun8i-h3-orangepi-zero-plus2.dtb"
UBOOT_MACHINE = "orangepi_zero_plus2_h3_defconfig"
```

## conf/machine/orange-pi-zero.conf
```bitbake
#@TYPE: Machine
#@NAME: orange-pi-zero
#@DESCRIPTION: Machine configuration for the orange-pi-zero, based on Allwinner H2 CPU

require conf/machine/include/sun8i.inc

KERNEL_DEVICETREE = "allwinner/sun8i-h2-plus-orangepi-zero.dtb"
UBOOT_MACHINE = "orangepi_zero_defconfig"
```

## conf/machine/orange-pi-zero2.conf
```bitbake
#@TYPE: Machine
#@NAME: orange-pi-zero-2
#@DESCRIPTION: Machine configuration for the orange-pi-zero-2, based on Allwinner H616 CPU

require conf/machine/include/sun50i-h616.inc

KERNEL_DEVICETREE = "allwinner/sun50i-h616-orangepi-zero2.dtb"
UBOOT_MACHINE = "orangepi_zero2_defconfig"

SPL_BINARY = "u-boot-sunxi-with-spl.bin"

# as for now neither graphics nor audio is supported
MACHINE_FEATURES:remove = "alsa x11"
MACHINE_FEATURES:append = "bluetooth wifi"

MACHINE_EXTRA_RRECOMMENDS = "uwe5622-firmware"

# Load modules for wifi & bt
# Note: fo wifi a custom hci attach userspace sofware is needed that is not included in the layer
KERNEL_MODULE_AUTOLOAD += " sprdwl_ng sprdbt_tty "
```

## conf/machine/orange-pi-zero3.conf
```bitbake
#@TYPE: Machine
#@NAME: orange-pi-zero-3
#@DESCRIPTION: Machine configuration for the orange-pi-zero-3, based on Allwinner H618 CPU

require conf/machine/include/sun50i-h616.inc

KERNEL_DEVICETREE = "allwinner/sun50i-h618-orangepi-zero3.dtb"
IMAGE_BOOT_FILES = "${KERNEL_IMAGETYPE} boot.scr ${@d.getVar('KERNEL_DEVICETREE', '').split('/')[-1]};${KERNEL_DEVICETREE}}"
UBOOT_MACHINE = "orangepi_zero3_defconfig"

SPL_BINARY = "u-boot-sunxi-with-spl.bin"

SUNXI_BOOT_SPACE = "50"

# as for now neither graphics nor audio is supported
MACHINE_FEATURES:remove = "alsa x11"
MACHINE_FEATURES:append = "bluetooth wifi"

MACHINE_EXTRA_RRECOMMENDS = "uwe5622-firmware"

# Load modules for wifi & bt
# Note: fo wifi a custom hci attach userspace sofware is needed that is not included in the layer
KERNEL_MODULE_AUTOLOAD += " sprdwl_ng sprdbt_tty "
```

## conf/machine/pcduino.conf
```bitbake
#@TYPE: Machine
#@NAME: pcduino-lite-wifi
#@DESCRIPTION: Machine configuration for the pcDuino-Lite-Wifi, base on allwinner a10 CPU

require conf/machine/include/sun4i.inc

KERNEL_DEVICETREE = "allwinner/sun4i-a10-pcduino.dtb"
UBOOT_MACHINE = "Linksprite_pcDuino_defconfig"
SUNXI_FEX_FILE = "sys_config/a10/pcduino.fex"
```

## conf/machine/pcduino3.conf
```bitbake
#@TYPE: Machine
#@NAME: Linksprite A20-pcduino3 Board
#@DESCRIPTION: Machine configuration for the pcDuino 3, based on Allwinner A20 CPU

require conf/machine/include/sun7i.inc

KERNEL_DEVICETREE = "allwinner/sun7i-a20-pcduino3.dtb"
UBOOT_MACHINE = "Linksprite_pcDuino3_defconfig"
SUNXI_FEX_FILE = "sys_config/a20/linksprite_pcduino3.fex"
```

## conf/machine/pine64-plus.conf
```bitbake
#@TYPE: Machine
#@NAME: pine64-plus
#@DESCRIPTION: Machine configuration for the pine64-plus, based on Allwinner A64 CPU


require conf/machine/include/sun50i.inc

KERNEL_DEVICETREE = "allwinner/sun50i-a64-pine64-plus.dtb"
UBOOT_MACHINE = "pine64_plus_defconfig"
UBOOT_BINARY = "u-boot-sunxi-with-spl.bin"
SPL_BINARY = "u-boot-sunxi-with-spl.bin"
USE_SPLIT_UBOOT_SPL = "0"
```
